## components/emd_proctol/Kconfig.projbuild
```kconfig
menu "EMD_PROCTOL"
config EMD_PROCTOL_ENABLE
bool "Enable emd_proctol"
default "y"
endmenu
```

## components/ic_driver/Kconfig.projbuild
```kconfig
menu "IC_DRIVER"
config IC_DRIVER_ENABLE
bool "Enable ic_driver"
default "y"
endmenu
```
